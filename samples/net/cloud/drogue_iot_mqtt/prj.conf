## CMakeLists.txt
```
# SPDX-License-Identifier: Apache-2.0

cmake_minimum_required(VERSION 3.20.0)

find_package(Zephyr REQUIRED HINTS $ENV{ZEPHYR_BASE})
project(drogue_iot_mqtt)

target_sources(app PRIVATE src/main.c)
target_sources(app PRIVATE src/dhcp.c)
target_sources(app PRIVATE src/protocol.c)
zephyr_include_directories(${APPLICATION_SOURCE_DIR}/src/tls_config)

#set(gen_dir ${ZEPHYR_BINARY_DIR}/include/generated/)
#
#generate_inc_file_for_target(
#    app
#    src/mqtts-cert.der
#    ${gen_dir}/mqtts-cert.der.inc
#    )
```

## Kconfig
```
# Private config options for Drogue IoT application

# Copyright (c) 2022 Red Hat
# SPDX-License-Identifier: Apache-2.0

mainmenu "Drogue IoT HTTP/TLS sample application"

config DROGUE_HOSTNAME
	string "Hostname of Drogue IoT server"
	default "mqtt.sandbox.drogue.cloud"
	help
	  Set hostname string that matches the Drogue IoT server

config DROGUE_PORT
	string "Port of Drogue IoT server"
	default "443"
	help
	  Set port number string that matches the Drogue IoT server

config DROGUE_APPLICATION
    string "Drogue IoT application name"
	default "example-app"
	help
	  Set required application string that matches the Drogue IoT application

config DROGUE_DEVICE
    string "Drogue IoT device name"
	default "device1"
	help
	  Set required device string that matches the Drogue IoT device

config DROGUE_DEVICE_PASSWORD
    string "Drogue IoT device password"
	default "hey-rodney"
	help
	  Set required password string that matches the Drogue IoT device password

source "Kconfig.zephyr"
```

## sample.yaml
```
sample:
  description: MQTT sample app to Drogue IoT
  name: drogue_iot_mqtt
common:
  tags: net http cloud
  harness: net
  filter: TOOLCHAIN_HAS_NEWLIB == 1
  extra_args: USE_DUMMY_KEY=1
tests:
  sample.net.cloud.drogue_iot_mqtt:
    depends_on: netif
    platform_allow: frdm_k64f qemu_x86
```

## prj.conf
```kconfig
CONFIG_NETWORKING=y
CONFIG_NET_IPV6=n
CONFIG_NET_IPV4=y
CONFIG_NET_UDP=y
CONFIG_NET_TCP=y
CONFIG_NET_DHCPV4=y
CONFIG_STDOUT_CONSOLE=y

CONFIG_NET_PKT_RX_COUNT=4
CONFIG_NET_PKT_TX_COUNT=12
CONFIG_NET_BUF_RX_COUNT=16
CONFIG_NET_BUF_TX_COUNT=24
CONFIG_NET_BUF_DATA_SIZE=128

CONFIG_INIT_STACKS=y

CONFIG_NET_MGMT=y
CONFIG_NET_MGMT_EVENT=y

# This shouldn't need to be set, but isn't selected properly.
CONFIG_NEWLIB_LIBC=y

CONFIG_DNS_SERVER_IP_ADDRESSES=y
CONFIG_DNS_SERVER1="8.8.8.8"

CONFIG_DNS_RESOLVER=y
CONFIG_DNS_RESOLVER_ADDITIONAL_BUF_CTR=2
CONFIG_SNTP=y

CONFIG_SLIP_STATISTICS=n

CONFIG_HW_STACK_PROTECTION=y
CONFIG_MAIN_STACK_SIZE=4096


CONFIG_NET_SOCKETS=y
CONFIG_HTTP_CLIENT=y
CONFIG_NET_SOCKETS_SOCKOPT_TLS=y

CONFIG_BASE64=y

# Enable MBEDTLS
CONFIG_MBEDTLS=y
CONFIG_MBEDTLS_SSL_MAX_CONTENT_LEN=16384
CONFIG_MBEDTLS_BUILTIN=y


CONFIG_HEAP_MEM_POOL_SIZE=16384
CONFIG_NET_SOCKETS_POSIX_NAMES=y

CONFIG_MQTT_LIB=y
CONFIG_MQTT_LIB_TLS=y
CONFIG_MBEDTLS_ENABLE_HEAP=y
CONFIG_MBEDTLS_HEAP_SIZE=65536
CONFIG_MBEDTLS_USER_CONFIG_ENABLE=y
CONFIG_MBEDTLS_USER_CONFIG_FILE="user-tls-conf.h"
CONFIG_MBEDTLS_ECP_DP_SECP192R1_ENABLED=y
CONFIG_MBEDTLS_ECP_DP_SECP192R1_ENABLED=y
CONFIG_MBEDTLS_ECP_DP_SECP224R1_ENABLED=y
CONFIG_MBEDTLS_ECP_DP_SECP256R1_ENABLED=y
CONFIG_MBEDTLS_ECP_DP_SECP384R1_ENABLED=y
CONFIG_MBEDTLS_ECP_DP_SECP256K1_ENABLED=y
CONFIG_MBEDTLS_ECP_DP_BP256R1_ENABLED=y
CONFIG_MBEDTLS_ECP_DP_SECP192R1_ENABLED=y
CONFIG_MBEDTLS_CIPHER_GCM_ENABLED=y
CONFIG_MBEDTLS_KEY_EXCHANGE_ECDHE_ECDSA_ENABLED=y

# Please see README.rst in this directory for instructions
# on where to get the values for these config entries.
CONFIG_DROGUE_HOSTNAME="192.168.1.2.nip.io"
CONFIG_DROGUE_PORT="8883"
#CONFIG_DROGUE_HOSTNAME="mqtt.sandbox.drogue.cloud"
#CONFIG_DROGUE_PORT="443"
#CONFIG_DROGUE_HOSTNAME="mqtt-endpoint-drogue-dev.apps.wonderful.iot-playground.org"
#
CONFIG_DROGUE_APPLICATION="ulftest"
CONFIG_DROGUE_DEVICE="zephyr-example"
CONFIG_DROGUE_DEVICE_PASSWORD="1234"

#CONFIG_DROGUE_APPLICATION="example-app"
#CONFIG_DROGUE_DEVICE="device1"
#CONFIG_DROGUE_DEVICE_PASSWORD="hey-rodney"

# CONFIG_USE_SEGGER_RTT=y
# CONFIG_RTT_CONSOLE=y

CONFIG_LOG=y
CONFIG_LOG_MODE_DEFERRED=y
CONFIG_NET_LOG=y
CONFIG_LOG_RUNTIME_FILTERING=y
CONFIG_LOG_BUFFER_SIZE=2048
CONFIG_LOG_PRINTK=y
CONFIG_LOG_PROCESS_TRIGGER_THRESHOLD=0
CONFIG_COVERAGE=n
CONFIG_LOG_TAG_MAX_LEN=8


CONFIG_NET_TCP_LOG_LEVEL_DBG=n
CONFIG_NET_SOCKETS_LOG_LEVEL_DBG=n
CONFIG_NET_DHCPV4_LOG_LEVEL_INF=n
CONFIG_NET_IF_LOG_LEVEL_DBG=n
CONFIG_MBEDTLS_DEBUG=y
CONFIG_MBEDTLS_DEBUG_LEVEL=4
CONFIG_MQTT_LOG_LEVEL_DBG=y
CONFIG_NET_CONFIG_LOG_LEVEL_DBG=y
CONFIG_NET_CONNECTION_MANAGER_LOG_LEVEL_DBG=y
CONFIG_DNS_RESOLVER_LOG_LEVEL_DBG=y
CONFIG_NET_CONTEXT_LOG_LEVEL_DBG=y
CONFIG_WIFI_LOG_LEVEL_DBG=n
```

## src/main.c
```c
/* Full-stack IoT client example. */

/*
 * Copyright (c) 2018 Linaro Ltd
 *
 * SPDX-License-Identifier: Apache-2.0
 */

#include "dhcp.h"
#include "protocol.h"

#include <zephyr/net/net_config.h>
#include <zephyr/net/net_event.h>
#include <zephyr/net/sntp.h>
#include <zephyr/zephyr.h>

#define LOG_LEVEL CONFIG_LOG_DEFAULT_LEVEL
#include <zephyr/logging/log.h>

LOG_MODULE_REGISTER(net_drogue_iot_mqtt, LOG_LEVEL_INF);

/* This comes from newlib. */
#include <inttypes.h>
#include <time.h>

int64_t time_base;

int do_sntp(void)
{
	int rc;
	struct sntp_time sntp_time;
	char time_str[sizeof("1970-01-01T00:00:00")];

	LOG_INF("Sending NTP request for current time:");

	rc = sntp_simple("time.google.com", SYS_FOREVER_MS, &sntp_time);
	if (rc == 0) {
		time_base = sntp_time.seconds * MSEC_PER_SEC - k_uptime_get();

		/* Convert time to make sure. */
		time_t now = sntp_time.seconds;
		struct tm now_tm;

		gmtime_r(&now, &now_tm);
		strftime(time_str, sizeof(time_str), "%FT%T", &now_tm);
		// LOG_INF("  Acquired time: %s", log_strdup(time_str));

	} else {
		LOG_ERR("  Failed to acquire SNTP, code %d\n", rc);
	}
	return rc;
}

void main(void)
{
	LOG_INF("Drogue IoT - MQTT Client - Temperature demo");
	app_dhcpv4_startup();

	LOG_INF("Should have DHCPv4 lease at this point.");

	/* early return if we failed to acquire time */
	if (do_sntp() != 0) {
		LOG_ERR("Failed to get NTP time");
		return;
	}

	mqtt_startup();
}
```

## src/ca_certificate.h
```c
/*
 * Copyright (c) 2019 Intel Corporation
 *
 * SPDX-License-Identifier: Apache-2.0
 */

#define CA_CERTIFICATE_TAG 1

/* This is the same cert as what is found in net-tools/mqtts-cert.pem file
 */
static const unsigned char ca_certificate[] = {
#include "mqtts-cert.der.inc"
};
```

## src/dhcp.c
```c
/* DHCPv4 client startup. */

/*
 * Copyright (c) 2018 Linaro Ltd
 *
 * SPDX-License-Identifier: Apache-2.0
 */

#include <zephyr/logging/log.h>

LOG_MODULE_DECLARE(net_drogue_iot_mqtt, LOG_LEVEL_DBG);

#include <zephyr/net/net_context.h>
#include <zephyr/net/net_core.h>
#include <zephyr/net/net_if.h>
#include <zephyr/net/net_mgmt.h>
#include <zephyr/zephyr.h>

static struct net_mgmt_event_callback mgmt_cb;

/* Semaphore to indicate a lease has been acquired. */
static K_SEM_DEFINE(got_address, 0, 1);

static void handler(struct net_mgmt_event_callback *cb, uint32_t mgmt_event, struct net_if *iface)
{
	int i;
	bool notified = false;

	if (mgmt_event != NET_EVENT_IPV4_ADDR_ADD) {
		return;
	}

	for (i = 0; i < NET_IF_MAX_IPV4_ADDR; i++) {

		if (iface->config.ip.ipv4->unicast[i].addr_type != NET_ADDR_DHCP) {
			continue;
		}

		if (!notified) {
			k_sem_give(&got_address);
			notified = true;
		}
		break;
	}
}

/**
 * Start a DHCP client, and wait for a lease to be acquired.
 */
void app_dhcpv4_startup(void)
{
	LOG_INF("starting DHCPv4");

	net_mgmt_init_event_callback(&mgmt_cb, handler, NET_EVENT_IPV4_ADDR_ADD);
	net_mgmt_add_event_callback(&mgmt_cb);

	net_dhcpv4_start(net_if_get_default());

	/* Wait for a lease. */
	k_sem_take(&got_address, K_FOREVER);
}
```

## src/protocol.c
```c
/* Protocol implementation. */
/*
 * Copyright (c) 2018-2019 Linaro Ltd
 *
 * SPDX-License-Identifier: Apache-2.0
 */

#include <stdio.h>

#include <zephyr/logging/log.h>

LOG_MODULE_DECLARE(net_drogue_iot_mqtt, LOG_LEVEL_DBG);
#include "protocol.h"
#define APP_SLEEP_MSECS 8000

#include <string.h>

#include <zephyr/drivers/entropy.h>
#include <zephyr/net/mqtt.h>
#include <zephyr/net/tls_credentials.h>
#include <zephyr/zephyr.h>

#include <mbedtls/ctr_drbg.h>
#include <mbedtls/debug.h>
#include <mbedtls/entropy.h>
#include <mbedtls/platform.h>
#include <mbedtls/ssl.h>

extern int64_t time_base;

/* private key information */
extern unsigned char zepfull_private_der[];
extern unsigned int zepfull_private_der_len;

/*
 * This is the hard-coded root certificate that we accept.
 */
#include "globalsign.inc"

static uint8_t client_id[] = "foo";
static uint8_t client_username[512];
static uint8_t pub_topic[] = "telemetry";

static struct mqtt_publish_param pub_data;

static bool connected;
static uint64_t next_alive;

/* The mqtt client struct */
static struct mqtt_client client_ctx;

/* MQTT Broker details. */
static struct sockaddr_storage broker;

/* Buffers for MQTT client. */
static uint8_t rx_buffer[1024];
static uint8_t tx_buffer[1024];

static struct mqtt_utf8 username = {
	.utf8 = client_username,
};

static struct mqtt_utf8 password = {
	.utf8 = CONFIG_DROGUE_DEVICE_PASSWORD,
};

static sec_tag_t m_sec_tags[] = {
#if defined(MBEDTLS_X509_CRT_PARSE_C)
	1,
#endif
#if defined(MBEDTLS_KEY_EXCHANGE_SOME_PSK_ENABLED)
	APP_PSK_TAG,
#endif
};

/* Zephyr implementation of POSIX `time`.  Has to be called k_time
 * because time is already taken by newlib.  The clock will be set by
 * the SNTP client when it receives the time.  We make no attempt to
 * adjust it smoothly, and it should not be used for measuring
 * intervals.  Use `k_uptime_get()` directly for that.   Also the
 * time_t defined by newlib is a signed 32-bit value, and will
 * overflow in 2037.
 */
time_t my_k_time(time_t *ptr)
{
	int64_t stamp;
	time_t now;

	stamp = k_uptime_get();
	now = (time_t)((stamp + time_base) / 1000);

	if (ptr) {
		*ptr = now;
	}

	return now;
}

void mqtt_evt_handler(struct mqtt_client *const client, const struct mqtt_evt *evt)
{
	switch (evt->type) {
	case MQTT_EVT_SUBACK:
		LOG_INF("SUBACK packet id: %u", evt->param.suback.message_id);
		break;

	case MQTT_EVT_UNSUBACK:
		LOG_INF("UNSUBACK packet id: %u", evt->param.suback.message_id);
		break;

	case MQTT_EVT_CONNACK:
		if (evt->result != 0) {
			LOG_ERR("MQTT connect failed %d", evt->result);
			break;
		}

		connected = true;
		LOG_INF("MQTT client connected!");
		break;

	case MQTT_EVT_DISCONNECT:
		LOG_INF("MQTT client disconnected %d", evt->result);

		connected = false;

		break;

	case MQTT_EVT_PUBACK:
		if (evt->result != 0) {
			LOG_ERR("MQTT PUBACK error %d", evt->result);
			break;
		}

		/* increment message id for when we send next message */
		pub_data.message_id += 1U;
		LOG_INF("PUBACK packet id: %u", evt->param.puback.message_id);
		break;

	default:
		LOG_INF("MQTT event received %d", evt->type);
		break;
	}
}

static int wait_for_input(int timeout)
{
	int res;
	struct zsock_pollfd fds[1] = {
		[0] = {.fd = client_ctx.transport.tls.sock, .events = ZSOCK_POLLIN, .revents = 0},
	};

	res = zsock_poll(fds, 1, timeout);
	if (res < 0) {
		LOG_ERR("poll read event error");
		return -errno;
	}

	return res;
}

#define ALIVE_TIME (60 * MSEC_PER_SEC)

void mqtt_startup(void)
{
	int err, cnt;
	char pub_msg[64];
	struct sockaddr_in *broker4 = (struct sockaddr_in *)&broker;
	struct mqtt_client *client = &client_ctx;
	static struct zsock_addrinfo hints;
	struct zsock_addrinfo *haddr;
	int res = 0;
	int retries = 5;

	mbedtls_platform_set_time(my_k_time);

	err = tls_credential_add(1, TLS_CREDENTIAL_CA_CERTIFICATE, globalsign_certificate,
				 sizeof(globalsign_certificate));
	if (err < 0) {
		LOG_ERR("Failed to register public certificate: %d", err);
	}

	while (retries) {
		hints.ai_family = AF_INET;
		hints.ai_socktype = SOCK_STREAM;
		hints.ai_protocol = 0;
		cnt = 0;
		while ((err = getaddrinfo(CONFIG_DROGUE_HOSTNAME, CONFIG_DROGUE_PORT, &hints,
					  &haddr)) &&
		       cnt < 3) {
			LOG_ERR("Unable to get address for broker, retrying");
			cnt++;
		}

		if (err != 0) {
			LOG_ERR("Unable to get address for broker, error %d", err);
			return;
		}
		LOG_INF("DNS resolved for %s:%s", CONFIG_DROGUE_HOSTNAME, CONFIG_DROGUE_PORT);

		mqtt_client_init(client);

		int port = atoi(CONFIG_DROGUE_PORT);
		LOG_INF("DROGUE PORT: %d", port);
		broker4->sin_family = AF_INET;
		broker4->sin_port = htons(port);
		net_ipaddr_copy(&broker4->sin_addr, &net_sin(haddr->ai_addr)->sin_addr);

		sprintf(client_username, "%s@%s", CONFIG_DROGUE_DEVICE, CONFIG_DROGUE_APPLICATION);

		username.size = strlen(client_username);
		password.size = strlen(CONFIG_DROGUE_DEVICE_PASSWORD);

		/* MQTT client configuration */
		client->broker = &broker;
		client->keepalive = 0;
		client->evt_cb = mqtt_evt_handler;
		client->client_id.utf8 = client_id;
		client->client_id.size = 0;
		client->password = &password;
		client->user_name = &username;
		client->protocol_version = MQTT_VERSION_3_1_1;
		client->clean_session = 1;

		/* MQTT buffers configuration */
		client->rx_buf = rx_buffer;
		client->rx_buf_size = sizeof(rx_buffer);
		client->tx_buf = tx_buffer;
		client->tx_buf_size = sizeof(tx_buffer);

		/* MQTT transport configuration */
		client->transport.type = MQTT_TRANSPORT_SECURE;

		struct mqtt_sec_config *tls_config = &client->transport.tls.config;

		tls_config->peer_verify = TLS_PEER_VERIFY_NONE;
		tls_config->cipher_list = NULL;
		tls_config->sec_tag_list = m_sec_tags;
		tls_config->sec_tag_count = ARRAY_SIZE(m_sec_tags);
		tls_config->hostname = CONFIG_DROGUE_HOSTNAME;

		LOG_INF("Connecting to host: %s", CONFIG_DROGUE_HOSTNAME);
		err = mqtt_connect(client);
		if (err != 0) {
			LOG_ERR("could not connect, error %d", err);
			mqtt_disconnect(client);
			retries--;
			k_msleep(ALIVE_TIME);
			continue;
		}

		if (wait_for_input(5 * MSEC_PER_SEC) > 0) {
			mqtt_input(client);
			if (!connected) {
				LOG_ERR("failed to connect to mqtt_broker");
				mqtt_disconnect(client);
				retries--;
				k_msleep(ALIVE_TIME);
				continue;
			} else {
				break;
			}
		} else {
			LOG_ERR("failed to connect to mqtt broker");
			mqtt_disconnect(client);
			retries--;
			k_msleep(ALIVE_TIME);
			continue;
		}
	}

	if (!connected) {
		LOG_ERR("Failed to connect to client, aborting");
		return;
	}

	/* initialize publish structure */
	pub_data.message.topic.topic.utf8 = pub_topic;
	pub_data.message.topic.topic.size = strlen(pub_topic);
	pub_data.message.topic.qos = MQTT_QOS_1_AT_LEAST_ONCE;
	pub_data.message.payload.data = (uint8_t *)pub_msg;
	pub_data.message_id = 1U;
	pub_data.dup_flag = 0U;
	pub_data.retain_flag = 0U;

	mqtt_live(client);

	next_alive = k_uptime_get() + ALIVE_TIME;

	while (1) {
		LOG_INF("Publishing data");
		sprintf(pub_msg, "{\"temp\": 42.0}");
		pub_data.message.payload.len = strlen(pub_msg);
		err = mqtt_publish(client, &pub_data);
		if (err) {
			LOG_ERR("could not publish, error %d", err);
			break;
		}

		/* idle and process messages */
		while (k_uptime_get() < next_alive) {
			LOG_INF("... idling ...");
			if (wait_for_input(5 * MSEC_PER_SEC) > 0) {
				mqtt_input(client);
			}
		}

		mqtt_live(client);
		next_alive += ALIVE_TIME;
	}
}
```

## src/protocol.h
```c
/*
 * Copyright (c) 2018 Linaro Ltd
 *
 * SPDX-License-Identifier: Apache-2.0
 */

/*
 * MQTT-based cloud protocol engine.
 */

#ifndef PROTOCOL_H__
#define PROTOCOL_H__

#include <zephyr/net/socket.h>

void mqtt_startup(void);

#endif
```
